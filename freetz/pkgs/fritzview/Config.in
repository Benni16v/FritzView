## freetz/pkgs/fritzview/Config.in
```kconfig
config FREETZ_PACKAGE_FRITZVIEW
	bool "FritzView"
	default n
	select FREETZ_LIB_libusb
	help
		FritzView rendert Status-Displays und stellt
		ein Live-WebIF unter /fritzview bereit.
```
